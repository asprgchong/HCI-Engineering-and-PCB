/*
-----------------------------------------------------------------------------------------------------------------
-----------------------------------------------------------------------------------------------------------------
-----------------------------------------------------------------------------------------------------------------
Testing the mercury sensor to get sensor data every 2 seconds 
Rest mode: 
- Displays a timer
- Displays cat sleep
- Stops the timer if the circuit is not completed -- state != initialState
- Rest mode comes on every 10 minutes or is activated by press of a button
- After rest mode is done, the cat is rewarded. 
-----------------------------------------------------------------------------------------------------------------
-----------------------------------------------------------------------------------------------------------------
*/

  //Sensor determining the intial state as the resting state
  //and then turning the led on when it is not in the intitalstate
  //Tilted position to rest.
  // state = digitalRead(mercuryTilt);
  // while ()
  // if(state != initialState){
  //   digitalWrite(LED, HIGH); // turn LED ON if switch has been tilted
  //   digitalWrite(onBoardLed, HIGH); // echo output to Arduino’s LED
  //   //set the mode to be in rest mode --> just a timer of 5 secs
  // }
  // else{
  //   digitalWrite(LED, LOW);
  //   digitalWrite(onBoardLed, LOW);
  // }


/*
-----------------------------------------------------------------------------------------------------------------
-----------------------------------------------------------------------------------------------------------------
-----------------------------------------------------------------------------------------------------------------
Testing data transfer from rtt via python script to the arduino samd21, then output to the oled screen
-----------------------------------------------------------------------------------------------------------------
-----------------------------------------------------------------------------------------------------------------
*/
#include <RTTStream.h>
#include <Adafruit_GFX.h>
#include <Adafruit_SSD1306.h>
#include <Wire.h>
RTTStream rtt;

#define ADD_TODO 2
#define REMOVE_TODO 3
#define TIMER_PAUSE 4
#define MODE_CHANGE 5

#define SCREEN_WIDTH 128 // OLED display width, in pixels
#define SCREEN_HEIGHT 64 // OLED display height, in pixels

// Declaration for an SSD1306 display connected to I2C (SDA, SCL pins)
// The pins for I2C are defined by the Wire-library.
// On an arduino UNO:       A4(SDA), A5(SCL)
// On an arduino MEGA 2560: 20(SDA), 21(SCL)
// On an arduino LEONARDO:   2(SDA),  3(SCL), ...
#define PIN_WIRE_SDA 32
#define PIN_WIRE_SCL 33
#define OLED_RESET     -1// Reset pin # (or -1 if sharing Arduino reset pin)
#define SCREEN_ADDRESS 0x3C ///< See datasheet for Address; 0x3D for 128x64, 0x3C for 128x32
Adafruit_SSD1306 display(SCREEN_WIDTH, SCREEN_HEIGHT, &Wire, OLED_RESET);

int x = 0;
int y = 0;
int stringCount = 0;
int charNum = 0;
char stringInputted[4][40];

void setup(){
  display.begin(SSD1306_SWITCHCAPVCC, 0x3C);
  display.display();
  delay(2000); // Pause for 2 seconds
  // Clear the buffer
  display.clearDisplay();
  rtt.println("Testing data transfer");
  display.drawRect(0, 0, 128, 54, WHITE);
  display.display();
}

void loop(){
  while (rtt.available()) {
    rtt.write("samd received: ");
    char c = rtt.read();
    if (c == '\n'){
      rtt.write(stringInputted[stringCount]);
      stringCount++;
    } else {
      stringInputted[stringCount][charNum] = c;
      charNum++;
    }
    
    rtt.write(c);
    if (x == 22 || c == '\n'){
      y++;
    }
    display.setCursor(0+(x*6),y);
    display.setTextSize(2);
    display.setTextColor(SSD1306_WHITE);
    display.write(c);
    display.display();
    delay(1000);
    x++;
  }

  display.clearDisplay();
}
/*
-----------------------------------------------------------------------------------------------------------------
-----------------------------------------------------------------------------------------------------------------
-----------------------------------------------------------------------------------------------------------------
THIS IS FOR SETTING UP SERIAL2 FOR THE WIFI
-----------------------------------------------------------------------------------------------------------------
-----------------------------------------------------------------------------------------------------------------
*/
// #include <Arduino.h>   // required before wiring_private.h
// #include "wiring_private.h"

// Uart Serial2 (&sercom1, 12, 10, SERCOM_RX_PAD_3, UART_TX_PAD_2);
// void SERCOM1_Handler()
// {
//   Serial2.IrqHandler();
// }

// void setup() {
//   Serial.begin(115200);
//   Serial2.begin(115200);
//   pinPeripheral(10, PIO_SERCOM);
//   pinPeripheral(11, PIO_SERCOM);
// }

// uint8_t i=0;
// void loop() {
//   Serial.print(i);
//   Serial2.write(i++);
//   if (Serial2.available()) {
//     Serial.print(" -> 0x"); Serial.print(Serial2.read(), HEX);
//   }
//   Serial.println();
  
//   delay(10);
// }

/*
-----------------------------------------------------------------------------------------------------------------
-----------------------------------------------------------------------------------------------------------------
-----------------------------------------------------------------------------------------------------------------
THIS IS FOR TESTING THE LEDS
-----------------------------------------------------------------------------------------------------------------
-----------------------------------------------------------------------------------------------------------------
*/

// int LED = 8; 
// // the setup function runs once when you press reset or power the board
// void setup() {
//   // initialize digital pin LED_BUILTIN as an output.
//   pinMode(LED, OUTPUT);
// }

// // the loop function runs over and over again forever
// void loop() {
//   analogWrite(LED, 0);  // turn the LED on (HIGH is the voltage level)
//   delay(1000);                      // wait for a second
//   analogWrite(LED, 255);   // turn the LED off by making the voltage LOW
//   delay(1000);   
// }

/*----------------------------------------------------------------------------------------------------------------
-----------------------------------------------------------------------------------------------------------------
-----------------------------------------------------------------------------------------------------------------
THIS IS FOR THE TESTING THE BUTTONS FUNCTIONALITY YAY --> also tested with OneButton Library
-----------------------------------------------------------------------------------------------------------------
-----------------------------------------------------------------------------------------------------------------
*/

// #include <RTTStream.h>
// RTTStream rtt;
// #define ADD_TODO 9
// #define REMOVE_TODO 4
// #define TIMER_PAUSE 3
// #define MODE_CHANGE 1 
// // variables will change:
// int buttonState1 = 0;         // variable for reading the pushbutton status
// int buttonState2 = 0;         // variable for reading the pushbutton status
// int buttonState3 = 0;         // variable for reading the pushbutton status
// int buttonState4 = 0;         // variable for reading the pushbutton status

// void setup() {
//   rtt.println("Program started");
//   // initialize the LED pin as an output:
//   pinMode(ADD_TODO, INPUT_PULLUP);
//   pinMode(REMOVE_TODO, INPUT_PULLUP);
//   pinMode(TIMER_PAUSE, INPUT_PULLUP);
//   pinMode(MODE_CHANGE, INPUT_PULLUP);
// }

// void loop() {
//   // read the state of the pushbutton value:
//   int buttonState1 = digitalRead(ADD_TODO);
//   int buttonState2 = digitalRead(REMOVE_TODO);
//   int buttonState3 = digitalRead(TIMER_PAUSE);
//   int buttonState4 = digitalRead(MODE_CHANGE);

//   // check if the pushbutton is pressed.
//   // if it is, the buttonState is HIGH:
//   if (buttonState1 == LOW) {
//     rtt.write("button1 pressed\n");
//     delay(1000);
//   } else {
//     rtt.write("button1 released\n");
//     delay(1000);
//   }

//   if (buttonState2 == HIGH) {
//     rtt.write("button2 pressed\n");
//     delay(1000);
//   } else {
//     rtt.write("button2 released\n");
//     delay(1000);
//   }

//   if (buttonState3 == HIGH) {
//     rtt.write("button3 pressed\n");
//     delay(1000);
//   } else {
//     rtt.write("button3 released\n");
//     delay(1000);
//   }

//   if (buttonState4 == HIGH) {
//     rtt.write("button4 pressed\n");
//     delay(1000);
//   } else {
//     rtt.write("button4 released\n");
//     delay(1000);
//   }
// }

/*
-----------------------------------------------------------------------------------------------------------------
-----------------------------------------------------------------------------------------------------------------
-----------------------------------------------------------------------------------------------------------------
THIS IS FOR THE SPEAKER TESTING
-----------------------------------------------------------------------------------------------------------------
-----------------------------------------------------------------------------------------------------------------
*/

// #include "Talkie.h"
// #include "Vocab_US_Large.h"

// int speaker = A0; 
// Talkie voice; 

// void setup() {
//   // put your setup code here, to run once:
//   pinMode(speaker, OUTPUT);
//   digitalWrite(speaker, HIGH);
//   voice.say(spPAUSE2);
//   voice.say(spc_GOOD);
//   voice.say(spc_EVENING);
//   voice.say(spPAUSE1);
//   voice.say(spc_THE);
//   voice.say(spc_TIME);
//   voice.say(spc_IS);
//   voice.say(spc_SEVEN);
//   voice.say(spc_FOURTY);
//   voice.say(spc_FIVE);
//   voice.say(spc_P_M_);
//   voice.say(spPAUSE1);
// }
// void loop(){

// }

/*
-----------------------------------------------------------------------------------------------------------------
-----------------------------------------------------------------------------------------------------------------
-----------------------------------------------------------------------------------------------------------------
THIS IS FOR THE OLED SCREEN WITH 4 BUTTONS TO CONTROL IT. 
AS A TO_DO LIST MODE
-----------------------------------------------------------------------------------------------------------------
-----------------------------------------------------------------------------------------------------------------
*/
#include <SPI.h>
#include <Wire.h>
#include <Adafruit_GFX.h>
#include <Adafruit_SSD1306.h>
#include <OneButton.h>

// Button Pins 
// PA07 - 9 - ONOFF Button - Digital High 
// PA08 - 4 - SOUND - Digital Low 
// PA09 - 3 - MODE - Digital Low
// PA10 - 1 - LIDARK - Digital Low
// #define ADD_TODO 9
// #define REMOVE_TODO 4
// #define TIMER_PAUSE 3
// #define MODE_CHANGE 1 
//------------------------------------For simulation, Button defs------------------//
#define ADD_TODO 2
#define REMOVE_TODO 3
#define TIMER_PAUSE 4
#define MODE_CHANGE 5 

// #define SCREEN_WIDTH 128 // OLED display width, in pixels
// #define SCREEN_HEIGHT 64 // OLED display height, in pixels

// // Declaration for an SSD1306 display connected to I2C (SDA, SCL pins)
// // The pins for I2C are defined by the Wire-library. 
// // On an arduino UNO:       A4(SDA), A5(SCL)
// // On an arduino MEGA 2560: 20(SDA), 21(SCL)
// // On an arduino LEONARDO:   2(SDA),  3(SCL), ...
// #define PIN_WIRE_SDA 32
// #define PIN_WIRE_SCL 33
// #define OLED_RESET     -1// Reset pin # (or -1 if sharing Arduino reset pin)
// #define SCREEN_ADDRESS 0x3C ///< See datasheet for Address; 0x3D for 128x64, 0x3C for 128x32
// Adafruit_SSD1306 display(SCREEN_WIDTH, SCREEN_HEIGHT, &myWire, OLED_RESET);

//------------------------------------For simulation, Screen intitalization------------------//
Adafruit_SSD1306 display = Adafruit_SSD1306(128, 64, &Wire);

// bool game_over, win;

uint8_t ball_update, paddle_update;
// uint8_t ball_dir_x = 1, ball_dir_y = 1;
//12 cols * 30 rows + 2 = 
const int sizeBytes = 362; 
const int frames = 2; 
// 'awake', 262x218px
// 'awake', 70x58px
// 'awake-removebg-preview', 70x71px
const unsigned char epd_bitmap_awake_removebg_preview [] PROGMEM = {
 0x00, 0x00, 0x00, 0x00, 0x00, 0x00, 0x00, 0x00, 0x00, 0x00, 0x00, 0x00, 0x00, 0x00, 0x00, 0x00, 
 0x00, 0x00, 0x00, 0x00, 0x00, 0x00, 0x00, 0x00, 0x00, 0x00, 0x00, 0x00, 0x00, 0x00, 0x00, 0x00, 
 0x00, 0x00, 0x00, 0x00, 0x00, 0x00, 0x00, 0x00, 0x00, 0x00, 0x00, 0x00, 0x00, 0x00, 0x00, 0x00, 
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 0x00, 0x00, 0x00, 0x00, 0x00, 0x00, 0x00, 0x00, 0x00, 0x00, 0x00, 0x00, 0x00, 0x00, 0x00
};
// 'sleep-removebg-preview', 70x58px
const unsigned char epd_bitmap_sleep_removebg_preview [] PROGMEM = {
 0x00, 0x00, 0x00, 0x00, 0x00, 0x00, 0x00, 0x00, 0x00, 0x00, 0x00, 0x00, 0x00, 0x00, 0x00, 0x00, 
 0x00, 0x00, 0x00, 0x00, 0x00, 0x00, 0x00, 0x00, 0x00, 0x00, 0x00, 0x00, 0x00, 0x00, 0x00, 0x00, 
 0x00, 0x00, 0x00, 0x00, 0x00, 0x00, 0x00, 0x00, 0x00, 0x00, 0x00, 0x00, 0x00, 0x00, 0x00, 0x00, 
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 0x00, 0x00, 0x00, 0x00, 0x00, 0x00, 0x00, 0x00, 0x00, 0x00
};

// 'waiting2-removebg-preview', 40x42px
const unsigned char waitingCat [] PROGMEM = {
 0x00, 0x00, 0x00, 0x00, 0x00, 0x00, 0x00, 0x00, 0x00, 0x00, 0x00, 0x00, 0x00, 0x00, 0x00, 0x00, 
 0x00, 0x00, 0x00, 0x00, 0x01, 0xc0, 0x00, 0x00, 0x00, 0x01, 0x20, 0x00, 0x00, 0x00, 0x03, 0xe0, 
 0x00, 0x00, 0x00, 0x04, 0xc8, 0x01, 0x80, 0x00, 0x04, 0xc8, 0x01, 0x80, 0x00, 0x04, 0xc7, 0x63, 
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 0x00, 0x00
};

// 'Screenshot_2024-05-15_at_12', 30x30px
const unsigned char bread [] PROGMEM = {
 0x00, 0x00, 0x00, 0x00, 0x00, 0x00, 0x00, 0x00, 0x00, 0x00, 0x00, 0x00, 0x00, 0x00, 0x00, 0x00, 
 0x02, 0x00, 0x00, 0x00, 0x00, 0x00, 0x00, 0x00, 0x00, 0x00, 0x00, 0x00, 0x00, 0x00, 0x00, 0x00, 
 0x00, 0x7c, 0x7c, 0x00, 0x00, 0xff, 0xfc, 0x20, 0x01, 0xff, 0xff, 0x20, 0x01, 0xff, 0xff, 0x20, 
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 0x00, 0x00, 0x00, 0x00, 0x00, 0x00, 0x00, 0x00
};

// unsigned long ball_update;
// unsigned long paddle_update;
// const uint8_t MCU_X = 12;
// uint8_t mcu_y = 16;
// const uint8_t PLAYER_X = 115;
// uint8_t player_y = 16;

//homeMenu setup
 int pic = 0;
 int todo_menu = 0;
 int prev_todomenu = 0;
 int taskCompleted = 0;
 int task_prev = 0;

 long lastmillis = 0;
 long maxtime = 30000;
 OneButton button(REMOVE_TODO,true);

#define mercuryTilt 12;
#define LED 6;
#define onBoardLed 18;
boolean state = false;
boolean initialState;

int x = 0;
int y = 0;
int stringCount = 0;
int charNum = 0;
char stringInputted[4][40];

void setup() 
{
   display.begin(SSD1306_SWITCHCAPVCC, 0x3C);

   // Display the splash screen (we're legally required to do so)
   display.display();
   unsigned long start = millis();

   pinMode(ADD_TODO, INPUT_PULLUP);
   pinMode(REMOVE_TODO, INPUT_PULLUP);
   pinMode(TIMER_PAUSE, INPUT_PULLUP);
   pinMode(MODE_CHANGE, INPUT_PULLUP);

   display.clearDisplay();
   //set up the screen
   drawLoad();

   //wait for 2 seconds 
   while(millis() - start < 2000);

   //show new screen
   display.display();

   button.attachClick(click);
   button.attachDoubleClick(doubleclick);
   // button1.attachDoubleClick(doubleclick1);
   // button.attachLongPressStop(longPressStop);
   // button.attachLongPressStart(longPressStart);
   //set the time to now
   // ball_update = millis();
   // paddle_update = ball_update;
   pinMode(mercuryTilt, INPUT);
   pinMode(LED,OUTPUT);
   pinMode(onBoardLed, OUTPUT);
   initialState = digitalRead(mercuryTilt);
   digitalWrite(LED, LOW); // start with LED off
}

//1 - Home, 2 - Todos, 3 - Yes/No
int prev_mode = 0;
int mode = 1;
int prev_pic = 0;
current = millis();

void loop() 
{
 button.tick();
 // //JUMP TO DEFAULT IF NO CLICK IS DETECTED
 // if (millis() >= (lastmillis + maxtime))
 // {
 //   pic = 0;
 // }

 //Home toggle
 if (digitalRead(MODE_CHANGE) == LOW || pic != prev_pic && mode == 1) {
   drawHome(pic);
   prev_pic = pic;
 } 

 if (digitalRead(ADD_TODO) == LOW){
   sleepyCat();
 }

 //back button
 if (digitalRead(TIMER_PAUSE) == LOW){
   mode = prev_mode;
   pic = 0;
   todo_menu = 0;
 }

 if (todo_menu != prev_todomenu){
   drawTodoList(todo_menu);
   prev_todomenu = todo_menu;
 }

 if (taskCompleted != task_prev){
   drawTaskComplete(taskCompleted);
   task_prev = taskCompleted;
 }

 if (current - millis() >= 10000){
   state = digitalRead(mercuryTilt);
   if(state != initialState){
     digitalWrite(LED, HIGH); // turn LED ON if switch has been tilted
     digitalWrite(onBoardLed, HIGH); // echo output to Arduino’s LED
     sleepyCat();
     sleepCat();
     current = millis();
   }
   else{
     digitalWrite(LED, LOW);
     digitalWrite(onBoardLed, LOW);
     display.clearDisplay();
     display.setCursor(50, 0);
     display.setTextSize(2);
     display.setTextColor(SSD1306_WHITE);
     display.write("Time to take a break!");
   }
 }
}

// Array of all bitmaps for convenience. (Total bytes used to store images in PROGMEM = 14432)
const int epd_bitmap_allArray_LEN = 2;
const unsigned char* epd_bitmap_allArray[2] = {
 epd_bitmap_awake_removebg_preview,
 epd_bitmap_sleep_removebg_preview 
};
void sleepyCat(void) {
 display.clearDisplay();

 display.drawBitmap(
   10,
   10,
   epd_bitmap_allArray[0], 
   70, 
   71, 
   1);
 display.display();
 delay(500);

 display.clearDisplay();

 display.drawBitmap(
   10,
   20,
   epd_bitmap_allArray[1], 
   70, 
   58, 
   1);
 display.display();
 delay(2000);
}

void drawLoad() 
{
 display.clearDisplay();
 //display.drawRect(0, 0, 128, 54, WHITE);
 display.setCursor(0, 0);
 display.setTextSize(2);
 display.setTextColor(SSD1306_WHITE);
 display.write("Welcome to TodoCat");

 display.setCursor(20, 50);
 display.setTextSize(1);
 display.setTextColor(SSD1306_WHITE);
 display.write("Press to begin");
 display.display();
}

// Array of all bitmaps for convenience. (Total bytes used to store images in PROGMEM = 240)
const int arrayHome_len = 2;
const unsigned char* arrayHome[2] = {
 waitingCat,
 bread
};

void drawHome(int menu){
 display.clearDisplay();
 display.setCursor(0,0);
 display.setTextSize(1.5);
 display.setTextColor(SSD1306_WHITE);
 display.write("Let's get this bread!");

 display.drawBitmap(
   5,
   20,
   arrayHome[0], 
   40, 
   42, 
   1);

 display.drawBitmap(
   35,
   40,
   arrayHome[1], 
   30, 
   30, 
   1);

 const unsigned char* homeMenuOptions[4] = {
   "Add Todo", 
   "Start your day", 
 };
 
 if (menu == 0){
   display.setCursor(60,21);  display.print (">Add Todo");
   display.setCursor(60,30);  display.setTextWrap(free); display.print (" Start day");
 }

 if (menu == 1){
   display.setCursor(60,21);  display.print (" Add Todo");
   display.setCursor(60,30);  display.setTextWrap(free); display.print (">Start day");
 }
 display.display();
 refresh();
}

int modeOneMax = 2;
int modeTwoMax = 3;
int modeThreeMax = 2;
void click(){
 lastmillis = millis();
 if (mode == 1){
   if(pic>=0 && pic<modeOneMax){
     if (pic >= 1){
       pic=0;
     }
     else if(pic < modeOneMax){
       pic++;
     }
   }
 } else if (mode == 2){
   if(todo_menu>=0 && todo_menu<modeTwoMax){
     if (todo_menu >= modeTwoMax-1){
       todo_menu=0;
     }
     else if(todo_menu < modeTwoMax){
       todo_menu++;
     }
   }
 } else if (mode == 3){
   if (taskCompleted >= 0 && taskCompleted<modeThreeMax){
     if (taskCompleted >= 1){
       taskCompleted = 0;
     } else if (taskCompleted < modeThreeMax){
       taskCompleted++;
     }
   }
 }
}


int todolist = 0;

void doubleclick(){
 lastmillis = millis();
 if (mode == 1){
   if (pic == 0){ //Add todo
     prev_mode = mode; 
     mode = 2;
     drawAddTodo();
   } else { //View todo list
     prev_mode = mode; 
     mode = 2; 
     drawTodoList(todo_menu);
   }
 } else if (mode == 2){
   mode = 3;
   drawTaskComplete(taskCompleted);
 } else if (mode == 3){
   if (taskCompleted == 1){
     mode = 2;
     drawTodoList(0);
   } else {
     mode = 4; 
     sleepyCat();
     drawTodoList(0);
     //need to delete a task from here. 
   }
 }
}

void drawAddTodo(){
 while (rtt.available()) {
   rtt.write("samd received: ");
   char c = rtt.read();
   if (c == '\n'){
     rtt.write(stringInputted[stringCount]);
     stringCount++;
   } else {
     stringInputted[stringCount][charNum] = c;
     charNum++;
   }

   rtt.write(c);
   if (x == 22 || c == '\n'){
     y++;
   }
   display.setCursor(0+(x*6),y);
   display.setTextSize(2);
   display.setTextColor(SSD1306_WHITE);
   display.write(c);
   display.display();
   delay(1000);
   x++;
 }

 display.clearDisplay();
}

void drawTodoList(int menu){
 display.clearDisplay();
 display.drawRect(0, 0, 128, 64, WHITE);
 if (menu == 0){
   display.setCursor(5,21);  display.print (">Add yeast");
   display.setCursor(5,30);  display.setTextWrap(free); display.print (" Add flour");
   display.setCursor(5,39);  display.setTextWrap(free); display.print (" Bake the bread");
 }

 if (menu == 1){
   display.setCursor(5,21);  display.print (" Add yeast");
   display.setCursor(5,30);  display.setTextWrap(free); display.print (">Add flour");
   display.setCursor(5,39);  display.setTextWrap(free); display.print (" Bake the bread");
 }

 if (menu == 2){
   display.setCursor(5,21);  display.print (" Add yeast");
   display.setCursor(5,30);  display.setTextWrap(free); display.print (" Add flour");
   display.setCursor(5,39);  display.setTextWrap(free); display.print (">Bake the bread");
 }
 display.display();
}

void drawTaskComplete(int taskComplete){
 display.clearDisplay();
 //Make the options and the menu
 //then use the below for the double click
 display.setCursor(30, 10); display.write("Have you \ncompleted this task?");
 if (taskComplete == 0){
   display.drawRect(18, 46, 35, 15, WHITE);
   display.drawRect(60, 46, 55, 15, WHITE);
   display.setCursor(20,50);  display.print (">Yes!");
   display.setCursor(65,50);  display.setTextWrap(free); display.print (" Go Back");
 } else {
   // mode = 4; 
   // sleepyCat();
   display.drawRect(18, 46, 35, 15, WHITE);
   display.drawRect(60, 46, 55, 15, WHITE);
   display.setCursor(20,50);  display.print (" Yes!");
   display.setCursor(65,50);  display.setTextWrap(free); display.print (">Go Back");
 }
 display.display();
}

void refresh()
{
 display.display();
 delay(00);
 display.clearDisplay();
}
